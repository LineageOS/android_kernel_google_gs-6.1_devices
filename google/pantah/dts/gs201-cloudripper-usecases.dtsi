// SPDX-License-Identifier: GPL-2.0-only
/*
 * Usecases specific to the gs101 platform
 *
 * Copyright 2020 Google,LLC
 *
 */

/* system use cases */
&max77759_chg {
	// external boost
	max77759,bst-on-gpio = <&max777x9_gpio 4 GPIO_ACTIVE_HIGH>;
	max77759,bst-sel-gpio = <&s2mpg12_gpio 3 GPIO_ACTIVE_HIGH>;
	max77759,extbst-ctl-gpio = <&max77759_tcpc_gpio 0 GPIO_ACTIVE_HIGH>;
	max77759,extbst-mode-gpio = <&s2mpg12_gpio 4 GPIO_ACTIVE_HIGH>;

	max77759,ls2-en-gpio = <&max20339_gpio 1 GPIO_ACTIVE_HIGH>;
	max77759,sw-en-gpio = <&max20339_gpio 4 GPIO_ACTIVE_HIGH>;

	// NBC workaround
	max77759,lsw1-is_open-gpio = <&max20339_gpio 5 GPIO_ACTIVE_HIGH>;
	max77759,lsw1-is_closed-gpio = <&max20339_gpio 6 GPIO_ACTIVE_HIGH>;
	max77759,vin-is_valid-gpio = <&max20339_gpio 3 GPIO_ACTIVE_HIGH>;

	//max77759,cpout-en-gpio = <&p9xxx_gpio 1 GPIO_ACTIVE_HIGH>;
	//max77759,cpout-ctl-gpio = <&p9xxx_gpio 3 GPIO_ACTIVE_HIGH>;

	/* b/202526678 handles for WLC_RX->WLC_RX+GPIO */
	max77759,wlc-en-gpio = <&gpp0 0 GPIO_ACTIVE_HIGH>;
	max77759,wlc-vout_is_invalid-gpio = <&p9xxx_gpio 14 GPIO_ACTIVE_HIGH>;
	/* b/202526678 add inhibit pin */
	max77759,wlc-vbus_en-gpio = <&p9xxx_gpio 15 GPIO_ACTIVE_HIGH>;
};
